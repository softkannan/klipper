## src/avr/maxproui/Kconfig
```kconfig
# Kconfig Serial Display settings for AVR processors

config MAXPROUI_SERIAL
    depends on USBSERIAL || MACH_atmega2560 || MACH_atmega1280 || MACH_atmega644p || MACH_atmega1284p
    bool "Enable Anycubic 4Max Pro Stock Display"
    default n

choice
    depends on MAXPROUI_SERIAL
    prompt "Stock Display Serial Port" if LOW_LEVEL_OPTIONS && (MACH_atmega2560 || MACH_atmega1280 || MACH_atmega644p || MACH_atmega1284p)
    default AVR_MAXPROUI_SERIAL_UART2 if !AVR_SERIAL_UART2 && (MACH_atmega2560 || MACH_atmega1280)
    default AVR_MAXPROUI_SERIAL_UART0 if !AVR_SERIAL_UART0
    default AVR_MAXPROUI_SERIAL_UART1
    help
        Select the serial device to use for the touchscreen.
    config AVR_MAXPROUI_SERIAL_UART0
        bool "UART0" if !AVR_SERIAL_UART0
    config AVR_MAXPROUI_SERIAL_UART1
        bool "UART1" if !AVR_SERIAL_UART1
    config AVR_MAXPROUI_SERIAL_UART2
        bool "UART2" if !AVR_SERIAL_UART2 && (MACH_atmega2560 || MACH_atmega1280)
    config AVR_MAXPROUI_SERIAL_UART3
        bool "UART3" if !AVR_SERIAL_UART3 && (MACH_atmega2560 || MACH_atmega1280)
endchoice

config MAXPROUI_SERIAL_PORT
    depends on MAXPROUI_SERIAL
    int
    default 3 if AVR_MAXPROUI_SERIAL_UART3
    default 2 if AVR_MAXPROUI_SERIAL_UART2
    default 1 if AVR_MAXPROUI_SERIAL_UART1
    default 0 if AVR_MAXPROUI_SERIAL_UART0
    default 2 if !AVR_SERIAL_UART2 && (MACH_atmega2560 || MACH_atmega1280)
    default 0 if !AVR_SERIAL_UART0
    default 1
```
